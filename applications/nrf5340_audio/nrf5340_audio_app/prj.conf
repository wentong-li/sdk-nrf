## CMakeLists.txt
```
#
# Copyright (c) 2022 Nordic Semiconductor ASA
#
# SPDX-License-Identifier: LicenseRef-Nordic-5-Clause
#

cmake_minimum_required(VERSION 3.10.0)

include(../projects.cmake)

# Create flag which defines whether to compile for the gateway/dongle or headset
add_compile_definitions(NRF5340_AUDIO_DEV_HEADSET=1)
add_compile_definitions(NRF5340_AUDIO_DEV_GATEWAY=2)

option(DEV_HEADSET "Compile for headset hardware" OFF)
option(DEV_GATEWAY "Compile for gateway (PC dongle) hardware" OFF)

if (DEV_HEADSET AND DEV_GATEWAY)
    message(FATAL_ERROR "The selected device cannot be both HEADSET and GATEWAY")
elseif (NOT DEV_HEADSET AND NOT DEV_GATEWAY)
    message(FATAL_ERROR "The selected device must be either HEADSET or GATEWAY")
elseif (DEV_HEADSET)
    add_compile_definitions(NRF5340_AUDIO_DEV=NRF5340_AUDIO_DEV_HEADSET)
    set(CONF_FILE "${CONF_FILE} ${CMAKE_CURRENT_SOURCE_DIR}/prj_headset.conf")
elseif (DEV_GATEWAY)
    add_compile_definitions(NRF5340_AUDIO_DEV=NRF5340_AUDIO_DEV_GATEWAY)
    set(CONF_FILE "${CONF_FILE} ${CMAKE_CURRENT_SOURCE_DIR}/prj_gateway.conf")
else()
    message(FATAL_ERROR "Neither HEADSET or GATEWAY has been set")
endif()

include($ENV{ZEPHYR_BASE}/cmake/app/boilerplate.cmake NO_POLICY_SCOPE)
project(NRF5340_AUDIO
        VERSION ${NRF5340_AUDIO_RELEASE_VERSION})

include(${NRF5340_AUDIO_REPO_ROOT}/verification/verify.cmake)

# Get the git commit
execute_process(COMMAND
  "${GIT_EXECUTABLE}" describe --match=DoNoTmAtCh --always --dirty
  WORKING_DIRECTORY "${CMAKE_SOURCE_DIR}"
  OUTPUT_VARIABLE NRF5340_AUDIO_CORE_APP_GIT_SHA1
  ERROR_QUIET OUTPUT_STRIP_TRAILING_WHITESPACE)

# Get the last commit date
execute_process(COMMAND
  "${GIT_EXECUTABLE}" log -1 --format=%ad --date=local
  WORKING_DIRECTORY "${CMAKE_SOURCE_DIR}"
  OUTPUT_VARIABLE NRF5340_AUDIO_CORE_APP_GIT_DATE
  ERROR_QUIET OUTPUT_STRIP_TRAILING_WHITESPACE)

string(TIMESTAMP NRF5340_AUDIO_CORE_APP_COMP_DATE "%a %b %d %H:%M:%S %Y")

# Generate fw_info_app.c
configure_file("${NRF5340_AUDIO_SRC}/utils/fw_info_app.c.in"
               "${CMAKE_BINARY_DIR}/fw_info_app.c"
               @ONLY)

# Target sources below are specific to the nRF5340 Audio DK HW

message("== Compiling for BOARD = ${BOARD} ==")

target_sources(app PRIVATE
    src/main.c
    ${CMAKE_BINARY_DIR}/fw_info_app.c
    )

# Include application events and configuration headers
zephyr_library_include_directories(
    src/audio
    src/bluetooth
    src/drivers
    src/events
    src/modules
    src/utils
    src/utils/macros
    )

zephyr_library_include_directories(app PRIVATE
        ${NRF5340_AUDIO_REPO_ROOT}/../../boards/arm/nrf5340_audio_dk_nrf5340)

# Application sources
add_subdirectory(src/audio)
add_subdirectory(src/bluetooth)
add_subdirectory(src/drivers)
add_subdirectory(src/events)
add_subdirectory(src/modules)
add_subdirectory(src/utils)

## Bluedroid SBC
# (Bluekitchen repository considered temporary until SBC is officially included in Zephyr)
if (CONFIG_SW_CODEC_SBC)
    # Locate sbc in local ncs tree
    if(SW_CODEC_SBC_PATH)
        # Do nothing, just use the provided path
    elseif(WEST)
        ## Use Python and west to find the path
        execute_process(
            COMMAND ${PYTHON_EXECUTABLE} -c
            "from west.manifest import Manifest; manifest = Manifest.from_file(); \
            print(manifest.get_projects(['btstack'])[0].posixpath)"
            OUTPUT_VARIABLE
            west_project_output
            RESULT_VARIABLE
            result
        )

        if(${result})
            message(FATAL_ERROR "Failed to find SBC, cannot build sample")
        endif()

        string(REGEX REPLACE "[\r\n]+" "" BLUEKITCHEN_BTSTACK_PATH "${west_project_output}")
        set(SW_CODEC_SBC_PATH "${BLUEKITCHEN_BTSTACK_PATH}/3rd-party/bluedroid")
    else()
        message(FATAL_ERROR "west not installed, please provide SW_CODEC_SBC_PATH to CMake")
    endif()

    target_include_directories(app PRIVATE ${SW_CODEC_SBC_PATH}/decoder/include/)
    target_include_directories(app PRIVATE ${SW_CODEC_SBC_PATH}/encoder/include/)

    target_sources(app PRIVATE
            ${SW_CODEC_SBC_PATH}/decoder/srce/alloc.c
            ${SW_CODEC_SBC_PATH}/decoder/srce/bitalloc.c
            ${SW_CODEC_SBC_PATH}/decoder/srce/bitalloc-sbc.c
            ${SW_CODEC_SBC_PATH}/decoder/srce/bitstream-decode.c
            ${SW_CODEC_SBC_PATH}/decoder/srce/decoder-oina.c
            ${SW_CODEC_SBC_PATH}/decoder/srce/decoder-private.c
            ${SW_CODEC_SBC_PATH}/decoder/srce/decoder-sbc.c
            ${SW_CODEC_SBC_PATH}/decoder/srce/dequant.c
            ${SW_CODEC_SBC_PATH}/decoder/srce/framing.c
            ${SW_CODEC_SBC_PATH}/decoder/srce/framing-sbc.c
            ${SW_CODEC_SBC_PATH}/decoder/srce/oi_codec_version.c
            ${SW_CODEC_SBC_PATH}/decoder/srce/synthesis-sbc.c
            ${SW_CODEC_SBC_PATH}/decoder/srce/synthesis-dct8.c
            ${SW_CODEC_SBC_PATH}/decoder/srce/synthesis-8-generated.c
      )

    target_sources(app PRIVATE
            ${SW_CODEC_SBC_PATH}/encoder/srce/sbc_analysis.c
            ${SW_CODEC_SBC_PATH}/encoder/srce/sbc_dct.c
            ${SW_CODEC_SBC_PATH}/encoder/srce/sbc_dct_coeffs.c
            ${SW_CODEC_SBC_PATH}/encoder/srce/sbc_enc_bit_alloc_mono.c
            ${SW_CODEC_SBC_PATH}/encoder/srce/sbc_enc_bit_alloc_ste.c
            ${SW_CODEC_SBC_PATH}/encoder/srce/sbc_enc_coeffs.c
            ${SW_CODEC_SBC_PATH}/encoder/srce/sbc_encoder.c
            ${SW_CODEC_SBC_PATH}/encoder/srce/sbc_packing.c
      )
endif()

## LC3
if (CONFIG_SW_CODEC_LC3)
    if (EXISTS ${LC3_ROOT}/CMakeLists.txt)
        include(${LC3_ROOT}/CMakeLists.txt)
    else()
        message(FATAL_ERROR "LC3 repository not found\n"
                "Do 'west config manifest.group-filter +nrf5340_audio' "
                "and then 'west update'.\n"
                "If access is denied, contact local Nordic Semiconductor "
                "support or use SBC codec")
    endif()
endif()

## Cirrus HW codec resources
include(${CIRRUS_ROOT}/CMakeLists.txt)
```

## Kconfig
```
#
# Copyright (c) 2018 Nordic Semiconductor ASA
#
# SPDX-License-Identifier: LicenseRef-Nordic-5-Clause
#

# Kconfig - general configuration options

menu "nRF5340 Audio Project"

choice NRF5340_AUDIO_TRANSPORT_MODE
	prompt "Choose BIS or CIS for ISO transport"
	default TRANSPORT_CIS

config TRANSPORT_BIS
	select EXPERIMENTAL
	bool "Use BIS ISO channel for audio streaming"

config TRANSPORT_CIS
	select EXPERIMENTAL
	bool "Use CIS ISO channel for audio streaming"

endchoice

#----------------------------------------------------------------------------#
rsource "src/audio/Kconfig"
rsource "src/bluetooth/Kconfig"
rsource "src/drivers/Kconfig"
rsource "src/events/Kconfig"
rsource "src/modules/Kconfig"
rsource "src/utils/Kconfig"

#----------------------------------------------------------------------------#
menu "Logging"

config LOG_MAIN_LEVEL
	int "Log level for main file"
	default 3

config PRINT_STACK_USAGE_MS
	depends on THREAD_ANALYZER && INIT_STACKS
	int "Print stack usage every x milliseconds"
	default 5000

endmenu # Log levels

#----------------------------------------------------------------------------#
endmenu # nRF5340 Audio Config

menu "Zephyr Kernel"
source "Kconfig.zephyr"
endmenu
```

## prj.conf
```kconfig
#
# Copyright (c) 2022 Nordic Semiconductor ASA
#
# SPDX-License-Identifier: LicenseRef-Nordic-5-Clause
#

# General
CONFIG_REBOOT=y
CONFIG_MAIN_THREAD_PRIORITY=10
CONFIG_MAIN_STACK_SIZE=1940

# As long as thread names are used, config must be set to "y"
CONFIG_THREAD_NAME=y

# Bluetooth
CONFIG_BT_PRIVACY=n
CONFIG_BT_GATT_CLIENT=y
CONFIG_BT_GATT_DYNAMIC_DB=y

# Make sure we have enough space to receive one frame of encoded data
# The values set below are extended for higher BLE transmission capability
CONFIG_BT_ISO_RX_MTU=190
CONFIG_BT_ISO_TX_MTU=190
CONFIG_BT_L2CAP_TX_BUF_COUNT=6
CONFIG_BT_RX_STACK_SIZE=1600
CONFIG_BT_BUF_ACL_RX_SIZE=259

# Not supported on Packetcraft controller
CONFIG_BT_ATT_ENFORCE_FLOW=n

# Only do pairing without bonding
CONFIG_BT_BONDABLE=n
CONFIG_BT_AUDIO=y
CONFIG_BT_EXT_ADV=y
CONFIG_BT_PER_ADV=y
CONFIG_BT_ISO_UNICAST=y
CONFIG_BT_ISO_BROADCASTER=y
CONFIG_BT_ISO_SYNC_RECEIVER=y

# Temporary, enable the following to meet BT_ISO dependencies
CONFIG_BT_OBSERVER=y
CONFIG_BT_PERIPHERAL=y

# Audio sync timer
CONFIG_NRFX_TIMER=y
CONFIG_NRFX_TIMER1=y
CONFIG_NRFX_DPPI=y

# Need to turn on SMP when involving services in LE audio profiles
CONFIG_BT_SMP=y

# Temporarily disabled connetion parameter and PHY update
CONFIG_BT_GAP_AUTO_UPDATE_CONN_PARAMS=n
CONFIG_BT_AUTO_PHY_UPDATE=n
CONFIG_BT_AUTO_DATA_LEN_UPDATE=n

# Required for calculating test tones
CONFIG_CMSIS_DSP=y
CONFIG_CMSIS_DSP_FASTMATH=y

# Channel assignment writes to UICR
CONFIG_NRFX_NVMC=y

# Avoid multi-build system build network core firmware
CONFIG_NCS_INCLUDE_RPMSG_CHILD_IMAGE=n

# Workaround to not use fatal_error.c in NCS. Note that the system may still
# reset on error depending on the build configuraion
CONFIG_RESET_ON_FATAL_ERROR=n
```

## prj_debug.conf
```kconfig
#
# Copyright (c) 2022 Nordic Semiconductor ASA
#
# SPDX-License-Identifier: LicenseRef-Nordic-5-Clause
#

# General
CONFIG_DEBUG=y
CONFIG_DEBUG_INFO=y
CONFIG_ASSERT=y
CONFIG_STACK_USAGE=y
CONFIG_THREAD_RUNTIME_STATS=y
CONFIG_STACK_SENTINEL=y
CONFIG_INIT_STACKS=y

# Uart driver
CONFIG_SERIAL=y
CONFIG_UART_NRFX=y

# Logging
CONFIG_LOG=y
CONFIG_LOG2_MODE_DEFERRED=y
CONFIG_LOG_BACKEND_UART=y
CONFIG_LOG_BACKEND_RTT=n
CONFIG_LOG_DEFAULT_LEVEL=4
CONFIG_NEWLIB_LIBC_FLOAT_PRINTF=y
CONFIG_LOG_TAG_MAX_LEN=2
CONFIG_LOG_TAG_DEFAULT="--"

# Console related defines
CONFIG_CONSOLE=y
CONFIG_RTT_CONSOLE=y
CONFIG_UART_CONSOLE=y

# Shell related defines
CONFIG_SHELL=y
CONFIG_KERNEL_SHELL=y
CONFIG_USE_SEGGER_RTT=y
## Disable logs on RTT
CONFIG_SHELL_RTT_INIT_LOG_LEVEL_NONE=y
CONFIG_SHELL_BACKEND_RTT=y
CONFIG_SHELL_BACKEND_SERIAL=n
CONFIG_SHELL_VT100_COLORS=y
CONFIG_SHELL_STACK_SIZE=1024
CONFIG_SHELL_CMD_BUFF_SIZE=128
## Reduce shell memory usage
CONFIG_SHELL_WILDCARD=n
CONFIG_SHELL_HELP_ON_WRONG_ARGUMENT_COUNT=n
CONFIG_SHELL_STATS=n
CONFIG_SHELL_CMDS=n
CONFIG_SHELL_HISTORY=y

# Turn off default shell commands
CONFIG_I2C_SHELL=n
CONFIG_HWINFO_SHELL=n
CONFIG_CLOCK_CONTROL_NRF_SHELL=n
CONFIG_FLASH_SHELL=n
CONFIG_DEVICE_SHELL=n

# Enable BT debug
CONFIG_BT_DEBUG_LOG=y
CONFIG_BT_LOG_LEVEL_WRN=y
```

## prj_gateway.conf
```kconfig
#
# Copyright (c) 2022 Nordic Semiconductor ASA
#
# SPDX-License-Identifier: LicenseRef-Nordic-5-Clause
#

# General
CONFIG_BT_CENTRAL=y
CONFIG_BT_BROADCASTER=y
CONFIG_BT_VCS_CLIENT=y
CONFIG_BT_DEVICE_NAME="NRF5340_AUDIO"
CONFIG_SYSTEM_WORKQUEUE_STACK_SIZE=4096

# USB related configs
CONFIG_USB_DEVICE_STACK=y

# Avoid redundant warnings for endpoint setting in USB stack
CONFIG_USB_DRIVER_LOG_LEVEL_ERR=y
CONFIG_USB_DEVICE_LOG_LEVEL_ERR=y

# Net buf options needed for USB stack
CONFIG_NET_BUF=y
# Size of 1ms of stereo audio in bytes (48kHz, 16 bit)
CONFIG_NET_BUF_USER_DATA_SIZE=192

# USB audio related configs
CONFIG_USB_DEVICE_AUDIO=y
## TODO: Nordic VID, change accordingly
CONFIG_USB_DEVICE_VID=0x1915
## TODO: Change for final product
CONFIG_USB_DEVICE_PID=0x530A
CONFIG_USB_DEVICE_PRODUCT="nRF5340 USB Audio"
CONFIG_USB_DEVICE_MANUFACTURER="Nordic Semiconductor AS"

# Dual headsets demo requires gateway to establish two ACL connections
# and two ISO connections
CONFIG_BT_MAX_CONN=2
CONFIG_BT_ISO_MAX_CHAN=2
CONFIG_BT_MAX_PAIRED=2
```

## prj_headset.conf
```kconfig
#
# Copyright (c) 2022 Nordic Semiconductor ASA
#
# SPDX-License-Identifier: LicenseRef-Nordic-5-Clause
#

# General
CONFIG_BT_PERIPHERAL=y
CONFIG_BT_VCS=y

# Temporarily disabled connection parameter update request from peripheral
# All connection parameters are controlled by central side
CONFIG_BT_GAP_PERIPHERAL_PREF_PARAMS=n

# Dual CIS demo requires headset to accept one ACL connection and one ISO channel
CONFIG_BT_MAX_CONN=1
CONFIG_BT_ISO_MAX_CHAN=1
```

## src/main.c
```c
/*
 * Copyright (c) 2018 Nordic Semiconductor ASA
 *
 * SPDX-License-Identifier: LicenseRef-Nordic-5-Clause
 */

#include <zephyr.h>
#include <debug/stack.h>
#include <device.h>
#include <string.h>
#include <drivers/gpio.h>

#include "macros_common.h"
#include "fw_info_app.h"
#include "led.h"
#include "button_handler.h"
#include "button_assignments.h"
#include "audio_codec.h"
#include "nrfx_clock.h"
#include "nrfx_gpiote.h"
#include "streamctrl.h"
#include "ble_core.h"
#include "pmic.h"
#include "board.h"
#include "power_module.h"
#include "sd_card.h"
#include "board_version.h"
#include "devicetree.h"
#include "audio_datapath.h"
#include "audio_i2s.h"
#include "audio_sync_timer.h"
#include "channel_assignment.h"
#include "hw_codec.h"
#include "audio_usb.h"

#include <logging/log.h>
LOG_MODULE_REGISTER(main, CONFIG_LOG_MAIN_LEVEL);

#if defined(CONFIG_INIT_STACKS)
/* Used for printing stack usage */
extern struct k_thread z_main_thread;
#endif /* defined(CONFIG_INIT_STACKS) */

static atomic_t ble_core_is_ready = (atomic_t) false;
static board_version_t board_rev;
#define SHARED_SPI DT_NODELABEL(spi4) /* SD card and HW codec share the SPI4 */

static int core_app_config(void)
{
	int ret;

	nrf_gpiote_latency_t latency = nrfx_gpiote_latency_get();

	if (latency != NRF_GPIOTE_LATENCY_LOWPOWER) {
		LOG_DBG("Setting gpiote latency to low power");
		nrfx_gpiote_latency_set(NRF_GPIOTE_LATENCY_LOWPOWER);
	}

	/* Use this to turn on 128 MHz clock for cpu_app */
	ret = nrfx_clock_divider_set(NRF_CLOCK_DOMAIN_HFCLK, NRF_CLOCK_HFCLK_DIV_1);
	RET_IF_ERR(ret - NRFX_ERROR_BASE_NUM);

	nrfx_clock_hfclk_start();
	while (!nrfx_clock_hfclk_is_running()) {
	}

	/* Workaround for issue with PCA10121 v0.7.0 related to SD-card */
	static const struct device *gpio_dev;

	gpio_dev = device_get_binding(DT_SPI_DEV_CS_GPIOS_LABEL(DT_NODELABEL(sdhc0)));
	if (!gpio_dev) {
		return -ENODEV;
	}

	ret = gpio_pin_configure(gpio_dev, DT_PROP(SHARED_SPI, mosi_pin),
				 GPIO_DS_ALT_HIGH | GPIO_DS_ALT_LOW);
	RET_IF_ERR(ret);
	ret = gpio_pin_configure(gpio_dev, DT_PROP(SHARED_SPI, sck_pin),
				 GPIO_DS_ALT_HIGH | GPIO_DS_ALT_LOW);
	RET_IF_ERR(ret);

	return 0;
}

static int leds_set(void)
{
	int ret;

	/* Blink LED 3 to indicate that APP core is running */
	ret = led_blink(LED_APP_3_GREEN);
	RET_IF_ERR(ret);

#if (NRF5340_AUDIO_DEV == NRF5340_AUDIO_DEV_HEADSET)
	enum audio_channel channel;

	ret = channel_assignment_get(&channel);
	if (ret) {
		/* Channel is not assigned yet: use default */
		channel = AUDIO_CHANNEL_DEFAULT;
	}

	if (channel == AUDIO_CHANNEL_LEFT) {
		ret = led_on(LED_APP_RGB, LED_COLOR_BLUE);
	} else {
		ret = led_on(LED_APP_RGB, LED_COLOR_MAGENTA);
	}

	RET_IF_ERR(ret);
#elif NRF5340_AUDIO_DEV == NRF5340_AUDIO_DEV_GATEWAY
	ret = led_on(LED_APP_RGB, LED_COLOR_GREEN);
	RET_IF_ERR(ret);
#endif /* (NRF5340_AUDIO_DEV == NRF5340_AUDIO_DEV_HEADSET) */

	return 0;
}

static int channel_assign_check(void)
{
#if (NRF5340_AUDIO_DEV == NRF5340_AUDIO_DEV_HEADSET) && CONFIG_AUDIO_HEADSET_CHANNEL_RUNTIME
	if (!channel_assignment_get(&(enum audio_channel){ AUDIO_CHANNEL_LEFT })) {
		/* Channel already assigned */
		return 0;
	}

	int ret;
	bool pressed;

	ret = button_pressed(BUTTON_VOLUME_DOWN, &pressed);
	RET_IF_ERR(ret);

	if (pressed) {
		return channel_assignment_set(AUDIO_CHANNEL_LEFT);
	}

	ret = button_pressed(BUTTON_VOLUME_UP, &pressed);
	RET_IF_ERR(ret);

	if (pressed) {
		return channel_assignment_set(AUDIO_CHANNEL_RIGHT);
	}
#endif

	return 0;
}

/* Callback from ble_core when the ble subsystem is ready */
void on_ble_core_ready(void)
{
	(void)atomic_set(&ble_core_is_ready, (atomic_t) true);
}

void main(void)
{
	int ret;

	LOG_DBG("nRF5340 APP core started");

	ret = led_init();
	ERR_CHK(ret);

	ret = button_handler_init();
	ERR_CHK(ret);

	ret = channel_assign_check();
	ERR_CHK(ret);

	ret = fw_info_app_print();
	ERR_CHK(ret);

	ret = core_app_config();
	ERR_CHK(ret);

	ret = board_version_valid_check();
	ERR_CHK(ret);

	ret = board_version_get(&board_rev);
	ERR_CHK(ret);

	if (board_rev.mask & BOARD_REVISION_VALID_MSK_MAX14690_PMIC) {
		ret = pmic_init();
		ERR_CHK(ret);

		ret = pmic_defaults_set();
		ERR_CHK(ret);
	}

	if (board_rev.mask & BOARD_VERSION_VALID_MSK_SD_CARD) {
		ret = sd_card_init();
		if (ret != -ENODEV) {
			ERR_CHK(ret);
		}
	}

	ret = power_module_init();
	ERR_CHK(ret);

#if ((NRF5340_AUDIO_DEV == NRF5340_AUDIO_DEV_GATEWAY) && (CONFIG_AUDIO_SOURCE_USB))
	ret = audio_usb_init();
	ERR_CHK(ret);
#else
	ret = audio_datapath_init();
	ERR_CHK(ret);
	ret = audio_sync_timer_init();
	ERR_CHK(ret);
	audio_i2s_init();
	ret = hw_codec_init();
	ERR_CHK(ret);
	audio_sync_timer_sync_evt_send();
#endif

	/* Initialize BLE, with callback for when BLE is ready */
	ret = ble_core_init(on_ble_core_ready);
	ERR_CHK(ret);

	/* Wait until ble_core/NET core is ready */
	while (!(bool)atomic_get(&ble_core_is_ready)) {
		(void)k_sleep(K_MSEC(100));
	}

	ret = leds_set();
	ERR_CHK(ret);

	ret = streamctrl_start();
	ERR_CHK(ret);

	ret = audio_datapath_tone_play(1000, 400, 1);
	ERR_CHK(ret);

	while (1) {
		streamctrl_event_handler();
		STACK_USAGE_PRINT("main", &z_main_thread);
	}
}
```

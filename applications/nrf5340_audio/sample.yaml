## applications/nrf5340_audio/sample.yaml
```yaml
sample:
  name: nRF5340 Audio
  description: LE Audio sample
tests:
  applications.nrf5340_audio:
    build_only: true
    platform_allow: nrf5340_audio_dk_nrf5340_cpuapp
    platform_exclude: nrf5340_audio_dk_nrf5340_cpuapp_ns
    integration_platforms:
      - nrf5340_audio_dk_nrf5340_cpuapp
    tags: ci_build
```

## subsys/bluetooth/services/wifi_provisioning/Kconfig.wifi_prov
```kconfig
#
# Copyright (c) 2022 Nordic Semiconductor ASA
#
# SPDX-License-Identifier: LicenseRef-Nordic-5-Clause
#

menuconfig BT_WIFI_PROVISIONING
	bool "Enable GATT Wi-Fi Provisioning service"
	select EXPERIMENTAL
	select BT_NRF_SERVICES
	select NANOPB

if BT_WIFI_PROVISIONING

module = BT_WIFI_PROVISIONING
module-str = wifi provisioning service
source "${ZEPHYR_BASE}/subsys/logging/Kconfig.template.log_config"

endif # BT_WIFI_PROVISIONING
```

## tests/nrf5340_audio/sw_codec_lc3/testcase.yaml
```yaml
tests:
  nrf5340_audio.sw_codec_lc3_test:
    platform_allow: nrf5340pdk_nrf5340_cpuapp nrf5340_audio_dk_nrf5340_cpuapp
    tags: sw_codec_lc3, nrf5340_audio_dk_tests
    timeout: 30
```
